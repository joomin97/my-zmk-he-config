## boards/shields/hallsplit64/Kconfig
```kconfig
# boards/shields/hallsplit64/Kconfig

config SHIELD_HALLSPLIT64 # 이 부분이 'CONFIG_ZMK_SHIELD_hallsplit64'여야 합니다.
    def_bool $(shields_list_contains,hallsplit64)
```

## boards/shields/hallsplit64/hallsplit64.defconfig
```kconfig
# Copyright (c) 2025 Joomin97
# SPDX-License-Identifier: MIT

CONFIG_ZMK_SHIELD_HALLSPLIT64=y
```
